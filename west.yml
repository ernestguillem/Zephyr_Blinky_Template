## west.yml
```yaml
manifest:
  defaults:
    remote: zephyrproject-rtos
  remotes:
    - name: zephyrproject-rtos
      url-base: https://github.com/zephyrproject-rtos
  self:
    path: apps
    west-commands: scripts/west-commands.yml
  projects:
    - name: zephyr
      remote: zephyrproject-rtos
      revision: v4.1.0
      import:
        name-allowlist:
          - zephyr
          - cmsis
          - hal_stm32
```
